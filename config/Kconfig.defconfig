## config/Kconfig.defconfig
```kconfig
if SHIELD_ROCKONV3

config ZMK_KEYBOARD_NAME
	default "rockonv3"
	
config SPI
    default y
	
endif
```

## config/boards/shields/rockonv3/Kconfig.shield
```kconfig
# Copyright (c) 2020 Pete Johanson
# SPDX-License-Identifier: MIT

config SHIELD_ROCKONV3
    def_bool $(shields_list_contains,rockonv3)
```
